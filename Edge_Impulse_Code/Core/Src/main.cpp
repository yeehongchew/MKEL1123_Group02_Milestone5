/* USER CODE BEGIN Header */
/**
  ******************************************************************************
  * @file           : main.c
  * @brief          : Main program body
  ******************************************************************************
  * @attention
  *
  * Copyright (c) 2022 STMicroelectronics.
  * All rights reserved.
  *
  * This software is licensed under terms that can be found in the LICENSE file
  * in the root directory of this software component.
  * If no LICENSE file comes with this software, it is provided AS-IS.
  *
  ******************************************************************************
  */
/* USER CODE END Header */
/* Includes ------------------------------------------------------------------*/
#include "main.h"

/* Private includes ----------------------------------------------------------*/
/* USER CODE BEGIN Includes */
#include "edge-impulse-sdk/classifier/ei_run_classifier.h"
using namespace ei;

//Fresh Orange
static float features0[] = {
		0xffffff, 0xffffff, 0xffffff, 0xffffff, 0xfffffe, 0xfefefe, 0xfffefe, 0xfeffff, 0xfefefe, 0xfffdfc, 0xffffff, 0xffffff,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 0xf7f6f6
};

//Stale Orange
static float features1[] = {
		0xfcfdff, 0xf9fbfe, 0xf9f9fe, 0xf5f7fd, 0xf4f5fe, 0xf3f4fc, 0xf1f3fb, 0xeff2f9, 0xeff2fa, 0xedf0f7, 0xf2f6ff, 0xe9e6ec,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 0xf2e6e4
};

//Fresh Apples
static float features2[] = {
		0x40404, 0x30303, 0x10101, 0x0, 0x0, 0x0, 0x60606, 0x313131, 0x696969, 0xadadad, 0xebebec, 0xffffff,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 0x30303
};

//Stale Apples
static float features3[] ={
		0x0, 0x0, 0x20202, 0x30303, 0x30303, 0x10101, 0x0, 0x0, 0x0, 0x90909, 0x313131, 0x727272,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 0x0
};

//Fresh Orange
int get_feature_data0(size_t offset, size_t length, float *out_ptr) {
    memcpy(out_ptr, features0 + offset, length * sizeof(float));
    return 0;
}
//Stale Orange
int get_feature_data1(size_t offset, size_t length, float *out_ptr) {
    memcpy(out_ptr, features1 + offset, length * sizeof(float));
    return 0;
}
//Fresh Apples
int get_feature_data2(size_t offset, size_t length, float *out_ptr) {
    memcpy(out_ptr, features2 + offset, length * sizeof(float));
    return 0;
}

//Stale Apples
int get_feature_data3(size_t offset, size_t length, float *out_ptr) {
    memcpy(out_ptr, features3 + offset, length * sizeof(float));
    return 0;
}

/* USER CODE END Includes */
/* Private typedef -----------------------------------------------------------*/
/* USER CODE BEGIN PTD */

/* USER CODE END PTD */

/* Private define ------------------------------------------------------------*/
/* USER CODE BEGIN PD */
/* USER CODE END PD */

/* Private macro -------------------------------------------------------------*/
/* USER CODE BEGIN PM */

/* USER CODE END PM */

/* Private variables ---------------------------------------------------------*/
 CRC_HandleTypeDef hcrc;

UART_HandleTypeDef huart2;

/* USER CODE BEGIN PV */

/* USER CODE END PV */

/* Private function prototypes -----------------------------------------------*/
void SystemClock_Config(void);
static void MX_GPIO_Init(void);
static void MX_USART2_UART_Init(void);
static void MX_CRC_Init(void);
/* USER CODE BEGIN PFP */

/* USER CODE END PFP */

/* Private user code ---------------------------------------------------------*/
/* USER CODE BEGIN 0 */
#include <stdarg.h>

void vprint(const char *fmt, va_list argp)
{
    char string[200];
    if(0 < vsprintf(string, fmt, argp)) // build string
    {
        HAL_UART_Transmit(&huart2, (uint8_t*)string, strlen(string), 0xffffff); // send message via UART
    }
}

void ei_printf(const char *format, ...) {
    va_list myargs;
    va_start(myargs, format);
    vprint(format, myargs);
    va_end(myargs);
}

/* USER CODE END 0 */

/**
  * @brief  The application entry point.
  * @retval int
  */
int main(void)
{
  /* USER CODE BEGIN 1 */

  /* USER CODE END 1 */

  /* MCU Configuration--------------------------------------------------------*/

  /* Reset of all peripherals, Initializes the Flash interface and the Systick. */
  HAL_Init();

  /* USER CODE BEGIN Init */

  /* USER CODE END Init */

  /* Configure the system clock */
  SystemClock_Config();

  /* USER CODE BEGIN SysInit */

  /* USER CODE END SysInit */

  /* Initialize all configured peripherals */
  MX_GPIO_Init();
  MX_USART2_UART_Init();
  MX_CRC_Init();
  /* USER CODE BEGIN 2 */

  /* USER CODE END 2 */

  /* Infinite loop */
  /* USER CODE BEGIN WHILE */
  while (1)
  {
    /* USER CODE END WHILE */
	  //Fresh Oranges
	  signal_t signal0;
	  signal0.total_length = sizeof(features0) / sizeof(features0[0]);
	  signal0.get_data = &get_feature_data0;
	  ei_impulse_result_t result0 = { 0 };
			EI_IMPULSE_ERROR res0 = run_classifier(&signal0, &result0, false);
			ei_printf("run_classifier returned: %d\n", res0);
			ei_printf("Predictions (Classification: %d ms.):",
				result0.timing.classification);

			// print the predictions
			ei_printf("[");
			for (size_t ix = 0; ix < EI_CLASSIFIER_LABEL_COUNT; ix++) {
				ei_printf_float(result0.classification[ix].value);
		#if EI_CLASSIFIER_HAS_ANOMALY == 1
				ei_printf(", ");
		#else
				if (ix != EI_CLASSIFIER_LABEL_COUNT - 1) {
					ei_printf(", ");
				}
		#endif
			}
		#if EI_CLASSIFIER_HAS_ANOMALY == 1
			ei_printf_float(result0.anomaly);
		#endif
			ei_printf("]\n");

		if(result0.classification[0].value > result0.classification[1].value && result0.classification[0].value > result0.classification[2].value && result0.classification[0].value > result0.classification[3].value && result0.classification[0].value > result0.classification[4].value)
			ei_printf("This is FRESH APPLE!\n");
		else if(result0.classification[1].value > result0.classification[0].value && result0.classification[1].value > result0.classification[2].value && result0.classification[1].value > result0.classification[3].value && result0.classification[1].value > result0.classification[4].value)
			ei_printf("This is STALE ORANGE!\n");
		else if(result0.classification[2].value > result0.classification[0].value && result0.classification[2].value > result0.classification[1].value && result0.classification[2].value > result0.classification[3].value && result0.classification[2].value > result0.classification[4].value)
			ei_printf("This is FRESH APPLE!\n");
		else if(result0.classification[3].value > result0.classification[0].value && result0.classification[3].value > result0.classification[1].value && result0.classification[3].value > result0.classification[2].value && result0.classification[3].value > result0.classification[4].value)
			ei_printf("This is STALE ORANGE!\n");
		else
			ei_printf("Unknown Item!\n");
		HAL_Delay(5000);

		//Stale Oranges
		signal_t signal1;
	    signal1.total_length = sizeof(features1) / sizeof(features1[0]);
	    signal1.get_data = &get_feature_data1;
		ei_impulse_result_t result1 = { 0 };
			EI_IMPULSE_ERROR res1 = run_classifier(&signal1, &result1, false);
			ei_printf("run_classifier returned: %d\n", res1);
			ei_printf("Predictions (Classification: %d ms.):",
				result1.timing.classification);

			// print the predictions
			ei_printf("[");
			for (size_t ix = 1; ix < EI_CLASSIFIER_LABEL_COUNT; ix++) {
				ei_printf_float(result1.classification[ix].value);
		#if EI_CLASSIFIER_HAS_ANOMALY == 1
				ei_printf(", ");
		#else
				if (ix != EI_CLASSIFIER_LABEL_COUNT - 1) {
					ei_printf(", ");
				}
		#endif
			}
		#if EI_CLASSIFIER_HAS_ANOMALY == 1
			ei_printf_float(result1.anomaly);
		#endif
			ei_printf("]\n");

		if(result1.classification[0].value > result1.classification[1].value && result1.classification[0].value > result1.classification[2].value && result1.classification[0].value > result1.classification[3].value && result1.classification[0].value > result1.classification[4].value)
			ei_printf("This is FRESH ORANGE!\n");
		else if(result1.classification[1].value > result1.classification[0].value && result1.classification[1].value > result1.classification[2].value && result1.classification[1].value > result1.classification[3].value && result1.classification[1].value > result1.classification[4].value)
			ei_printf("This is STALE ORANGE!\n");
		else if(result1.classification[2].value > result1.classification[0].value && result1.classification[2].value > result1.classification[1].value && result1.classification[2].value > result1.classification[3].value && result1.classification[2].value > result1.classification[4].value)
			ei_printf("This is FRESH APPLE!\n");
		else if(result1.classification[3].value > result1.classification[0].value && result1.classification[3].value > result1.classification[1].value && result1.classification[3].value > result1.classification[2].value && result1.classification[3].value > result1.classification[4].value)
			ei_printf("This is STALE APPLE!\n");
		else
			ei_printf("Unknown Item!\n");
		HAL_Delay(5000);

		//Fresh Apples
		signal_t signal2;
		signal2.total_length = sizeof(features2) / sizeof(features2[0]);
		signal2.get_data = &get_feature_data2;
		ei_impulse_result_t result2 = { 0 };
			EI_IMPULSE_ERROR res2 = run_classifier(&signal2, &result2, false);
			ei_printf("run_classifier returned: %d\n", res2);
			ei_printf("Predictions (Classification: %d ms.):",
				result2.timing.classification);

			// print the predictions
			ei_printf("[");
			for (size_t ix = 1; ix < EI_CLASSIFIER_LABEL_COUNT; ix++) {
				ei_printf_float(result2.classification[ix].value);
		#if EI_CLASSIFIER_HAS_ANOMALY == 1
				ei_printf(", ");
		#else
				if (ix != EI_CLASSIFIER_LABEL_COUNT - 1) {
					ei_printf(", ");
				}
		#endif
			}
		#if EI_CLASSIFIER_HAS_ANOMALY == 1
			ei_printf_float(result2.anomaly);
		#endif
			ei_printf("]\n");

		if(result2.classification[0].value > result2.classification[1].value && result2.classification[0].value > result2.classification[2].value && result2.classification[0].value > result2.classification[3].value && result2.classification[0].value > result2.classification[4].value)
			ei_printf("This is FRESH ORANGE!\n");
		else if(result2.classification[1].value > result2.classification[0].value && result2.classification[1].value > result2.classification[2].value && result2.classification[1].value > result2.classification[3].value && result2.classification[1].value > result2.classification[4].value)
			ei_printf("This is STALE ORANGE!\n");
		else if(result2.classification[2].value > result2.classification[0].value && result2.classification[2].value > result2.classification[1].value && result2.classification[2].value > result2.classification[3].value && result2.classification[2].value > result2.classification[4].value)
			ei_printf("This is FRESH APPLE!\n");
		else if(result2.classification[3].value > result2.classification[0].value && result2.classification[3].value > result2.classification[1].value && result2.classification[3].value > result2.classification[2].value && result2.classification[3].value > result2.classification[4].value)
			ei_printf("This is STALE APPLE!\n");
		else
			ei_printf("Unknown Item!\n");
		HAL_Delay(5000);

		//Stale Apples
		signal_t signal3;
	    signal3.total_length = sizeof(features3) / sizeof(features3[0]);
	    signal3.get_data = &get_feature_data3;
		ei_impulse_result_t result3 = { 0 };
			EI_IMPULSE_ERROR res1 = run_classifier(&signal3, &result3, false);
			ei_printf("run_classifier returned: %d\n", res1);
			ei_printf("Predictions (Classification: %d ms.):",
				result3.timing.classification);

			// print the predictions
			ei_printf("[");
			for (size_t ix = 1; ix < EI_CLASSIFIER_LABEL_COUNT; ix++) {
				ei_printf_float(result3.classification[ix].value);
		#if EI_CLASSIFIER_HAS_ANOMALY == 1
				ei_printf(", ");
		#else
				if (ix != EI_CLASSIFIER_LABEL_COUNT - 1) {
					ei_printf(", ");
				}
		#endif
			}
		#if EI_CLASSIFIER_HAS_ANOMALY == 1
			ei_printf_float(result1.anomaly);
		#endif
			ei_printf("]\n");

		if(result3.classification[0].value > result3.classification[1].value && result3.classification[0].value > result3.classification[2].value && result3.classification[0].value > result3.classification[3].value && result3.classification[0].value > result3.classification[4].value)
			ei_printf("This is FRESH ORANGE!\n");
		else if(result3.classification[1].value > result3.classification[0].value && result3.classification[1].value > result3.classification[2].value && result3.classification[1].value > result3.classification[3].value && result3.classification[1].value > result3.classification[4].value)
			ei_printf("This is STALE ORANGE!\n");
		else if(result3.classification[2].value > result3.classification[0].value && result3.classification[2].value > result3.classification[1].value && result3.classification[2].value > result3.classification[3].value && result3.classification[2].value > result3.classification[4].value)
			ei_printf("This is FRESH APPLE!\n");
		else if(result3.classification[3].value > result3.classification[0].value && result3.classification[3].value > result3.classification[1].value && result3.classification[3].value > result3.classification[2].value && result3.classification[3].value > result3.classification[4].value)
			ei_printf("This is STALE APPLE!\n");
		else
			ei_printf("Unknown Item!\n");
		HAL_Delay(5000);
    /* USER CODE BEGIN 3 */
  }
  /* USER CODE END 3 */
}

/**
  * @brief System Clock Configuration
  * @retval None
  */
void SystemClock_Config(void)
{
  RCC_OscInitTypeDef RCC_OscInitStruct = {0};
  RCC_ClkInitTypeDef RCC_ClkInitStruct = {0};

  /** Configure the main internal regulator output voltage
  */
  __HAL_RCC_PWR_CLK_ENABLE();
  __HAL_PWR_VOLTAGESCALING_CONFIG(PWR_REGULATOR_VOLTAGE_SCALE1);

  /** Initializes the RCC Oscillators according to the specified parameters
  * in the RCC_OscInitTypeDef structure.
  */
  RCC_OscInitStruct.OscillatorType = RCC_OSCILLATORTYPE_HSI;
  RCC_OscInitStruct.HSIState = RCC_HSI_ON;
  RCC_OscInitStruct.HSICalibrationValue = RCC_HSICALIBRATION_DEFAULT;
  RCC_OscInitStruct.PLL.PLLState = RCC_PLL_ON;
  RCC_OscInitStruct.PLL.PLLSource = RCC_PLLSOURCE_HSI;
  RCC_OscInitStruct.PLL.PLLM = 16;
  RCC_OscInitStruct.PLL.PLLN = 336;
  RCC_OscInitStruct.PLL.PLLP = RCC_PLLP_DIV4;
  RCC_OscInitStruct.PLL.PLLQ = 4;
  RCC_OscInitStruct.PLL.PLLR = 2;
  if (HAL_RCC_OscConfig(&RCC_OscInitStruct) != HAL_OK)
  {
    Error_Handler();
  }

  /** Initializes the CPU, AHB and APB buses clocks
  */
  RCC_ClkInitStruct.ClockType = RCC_CLOCKTYPE_HCLK|RCC_CLOCKTYPE_SYSCLK
                              |RCC_CLOCKTYPE_PCLK1|RCC_CLOCKTYPE_PCLK2;
  RCC_ClkInitStruct.SYSCLKSource = RCC_SYSCLKSOURCE_PLLCLK;
  RCC_ClkInitStruct.AHBCLKDivider = RCC_SYSCLK_DIV1;
  RCC_ClkInitStruct.APB1CLKDivider = RCC_HCLK_DIV2;
  RCC_ClkInitStruct.APB2CLKDivider = RCC_HCLK_DIV1;

  if (HAL_RCC_ClockConfig(&RCC_ClkInitStruct, FLASH_LATENCY_2) != HAL_OK)
  {
    Error_Handler();
  }
}

/**
  * @brief CRC Initialization Function
  * @param None
  * @retval None
  */
static void MX_CRC_Init(void)
{

  /* USER CODE BEGIN CRC_Init 0 */

  /* USER CODE END CRC_Init 0 */

  /* USER CODE BEGIN CRC_Init 1 */

  /* USER CODE END CRC_Init 1 */
  hcrc.Instance = CRC;
  if (HAL_CRC_Init(&hcrc) != HAL_OK)
  {
    Error_Handler();
  }
  /* USER CODE BEGIN CRC_Init 2 */

  /* USER CODE END CRC_Init 2 */

}

/**
  * @brief USART2 Initialization Function
  * @param None
  * @retval None
  */
static void MX_USART2_UART_Init(void)
{

  /* USER CODE BEGIN USART2_Init 0 */

  /* USER CODE END USART2_Init 0 */

  /* USER CODE BEGIN USART2_Init 1 */

  /* USER CODE END USART2_Init 1 */
  huart2.Instance = USART2;
  huart2.Init.BaudRate = 115200;
  huart2.Init.WordLength = UART_WORDLENGTH_8B;
  huart2.Init.StopBits = UART_STOPBITS_1;
  huart2.Init.Parity = UART_PARITY_NONE;
  huart2.Init.Mode = UART_MODE_TX_RX;
  huart2.Init.HwFlowCtl = UART_HWCONTROL_NONE;
  huart2.Init.OverSampling = UART_OVERSAMPLING_16;
  if (HAL_UART_Init(&huart2) != HAL_OK)
  {
    Error_Handler();
  }
  /* USER CODE BEGIN USART2_Init 2 */

  /* USER CODE END USART2_Init 2 */

}

/**
  * @brief GPIO Initialization Function
  * @param None
  * @retval None
  */
static void MX_GPIO_Init(void)
{
  GPIO_InitTypeDef GPIO_InitStruct = {0};

  /* GPIO Ports Clock Enable */
  __HAL_RCC_GPIOC_CLK_ENABLE();
  __HAL_RCC_GPIOH_CLK_ENABLE();
  __HAL_RCC_GPIOA_CLK_ENABLE();
  __HAL_RCC_GPIOB_CLK_ENABLE();

  /*Configure GPIO pin Output Level */
  HAL_GPIO_WritePin(LD2_GPIO_Port, LD2_Pin, GPIO_PIN_RESET);

  /*Configure GPIO pin : B1_Pin */
  GPIO_InitStruct.Pin = B1_Pin;
  GPIO_InitStruct.Mode = GPIO_MODE_IT_FALLING;
  GPIO_InitStruct.Pull = GPIO_NOPULL;
  HAL_GPIO_Init(B1_GPIO_Port, &GPIO_InitStruct);

  /*Configure GPIO pin : LD2_Pin */
  GPIO_InitStruct.Pin = LD2_Pin;
  GPIO_InitStruct.Mode = GPIO_MODE_OUTPUT_PP;
  GPIO_InitStruct.Pull = GPIO_NOPULL;
  GPIO_InitStruct.Speed = GPIO_SPEED_FREQ_LOW;
  HAL_GPIO_Init(LD2_GPIO_Port, &GPIO_InitStruct);

}

/* USER CODE BEGIN 4 */

/* USER CODE END 4 */

/**
  * @brief  This function is executed in case of error occurrence.
  * @retval None
  */
void Error_Handler(void)
{
  /* USER CODE BEGIN Error_Handler_Debug */
  /* User can add his own implementation to report the HAL error return state */
  __disable_irq();
  while (1)
  {
  }
  /* USER CODE END Error_Handler_Debug */
}

#ifdef  USE_FULL_ASSERT
/**
  * @brief  Reports the name of the source file and the source line number
  *         where the assert_param error has occurred.
  * @param  file: pointer to the source file name
  * @param  line: assert_param error line source number
  * @retval None
  */
void assert_failed(uint8_t *file, uint32_t line)
{
  /* USER CODE BEGIN 6 */
  /* User can add his own implementation to report the file name and line number,
     ex: printf("Wrong parameters value: file %s on line %d\r\n", file, line) */
  /* USER CODE END 6 */
}
#endif /* USE_FULL_ASSERT */
